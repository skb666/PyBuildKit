## Kconfig
```kconfig
mainmenu "C/CPP CMake project framework Kconfig configuration"

menu "Toolchain configuration"
    config TOOLCHAIN_PATH
        string "toolchain path"
        default ""

    config TOOLCHAIN_PREFIX
        string "toolchain prefix"
        default ""
endmenu

menu "Components configuration"
    config USING_VCPKG
        depends on (TOOLCHAIN_PATH = "$(VCPKG_ROOT)/scripts/buildsystems/vcpkg.cmake")
        bool "using vcpkg"
        default n

    osource "${SDK_PATH}/components/*/Kconfig"
    osource "${PROJECT_PATH}/../components/*/Kconfig"
    osource "${PROJECT_PATH}/*/Kconfig"
endmenu
```

## template/components/event/Kconfig
```kconfig
config EVENT_ENABLED
    depends on USING_VCPKG
    bool "enable event"
    help
        通过 vcpkg 安装的 libevent
    default n
```

## template/test_rust/utils_rust/Kconfig
```kconfig
config UTILS_RUST_ENABLED
    bool "enable utils_rust"
    help
        使用 rust 外导符号
    default n
```
